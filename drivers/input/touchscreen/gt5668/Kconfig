## drivers/input/touchscreen/gt5668/Kconfig
```kconfig
config TOUCHSCREEN_GT5668            
	tristate "GT5668 touchscreen"
	default n
	depends on I2C
	help
	  Say Y here if you have a GT5668 touchscreen
```
